//
// Created by lovro on 24/03/2026.
// Copyright (c) 2026 lovro. All rights reserved.
//

#include "st7920.h"

#include <stdio.h>
#include <string.h>
#include <stdarg.h>

#include "smallgpio.h"

SPI_HandleTypeDef *ST7920_Spi = NULL;

sgpio ST7920_PIN_CS  = SGPIO_FROM_MACRO(LCD_CS);
sgpio ST7920_PIN_RST = SGPIO_FROM_MACRO(LCD_RST);

u8 ST7920_FrontBuf[64 * (7 + 32)] = {0};
u8 ST7920_BackBuf[1024]           = {0};

int ST7920_CursorX = 0, ST7920_CursorY = 0;
int ST7920_OriginX = 0, ST7920_OriginY = 0;
int ST7920_WrapX   = 0;

void ST7920_Init(SPI_HandleTypeDef *spi)
{
    ST7920_Spi = spi;

    for (int y = 0, i = 0; y < 64; y++)
    {
        ST7920_FrontBuf[i++] = 0xF8;
        ST7920_FrontBuf[i++] = (0x80 | y) & 0xF0;
        ST7920_FrontBuf[i++] = (0x80 | (y << 4)) & 0xF0;

        int x = 0;

        ST7920_FrontBuf[i++] = 0xF8;
        ST7920_FrontBuf[i++] = (0x80 | x) & 0xF0;
        ST7920_FrontBuf[i++] = (0x80 | (x << 4)) & 0xF0;

        ST7920_FrontBuf[i++] = 0xFA;

        i += 32;
    }

    SGPIO_Low(&ST7920_PIN_RST);
    HAL_Delay(100);

    SGPIO_High(&ST7920_PIN_RST);
    HAL_Delay(100);

    ST7920_SendCommand(0x30);
    HAL_Delay(1);

    ST7920_SendCommand(0x30);
    HAL_Delay(1);

    ST7920_SendCommand(0x1);
    HAL_Delay(50);

    ST7920_SendCommand(0x6);
    HAL_Delay(1);

    ST7920_SendCommand(0xC);
    HAL_Delay(1);
}

void ST7920_SendCommand(u8 data)
{
    SGPIO_High(&ST7920_PIN_CS);

    u8 bytes[] = {0b11111000, data & 0xF0, data << 4};
    HAL_SPI_Transmit(ST7920_Spi, bytes, 3, 1000);

    SGPIO_Low(&ST7920_PIN_CS);
}

void ST7920_BackToFront()
{
    // the first byte is the sync byte. skip it.
    u8 *dst = ST7920_FrontBuf + 7;
    u8 *src = ST7920_BackBuf;

    for (int i = 0; i < 64; i++)
    {
        for (int j = 0; j < 16; j++)
        {
            u8 x     = *(src++);
            *(dst++) = x & 0xF0;
            *(dst++) = x << 4;
        }

        dst += 7;
    }
}

void ST7920_SendFrameDMA()
{
    SGPIO_High(&ST7920_PIN_CS);

    HAL_SPI_Transmit_DMA(ST7920_Spi, ST7920_FrontBuf, ARRAY_CNT(ST7920_FrontBuf));

    SGPIO_Low(&ST7920_PIN_CS);
}

void ST7920_SetOrigin(u8 x, u8 y)
{
    ST7920_OriginX = x;
    ST7920_OriginY = y;
}

void ST7920_Seek(u8 x, u8 y)
{
    ST7920_CursorX = x;
    ST7920_CursorY = y;
}

// drawing functions

char ST7920_PrintfBuf[256];

void ST7920_Printf(char *format, ...)
{
    va_list args;
    va_start(args, format);

    vsprintf(ST7920_PrintfBuf, format, args);
    ST7920_DrawString(ST7920_PrintfBuf);

    va_end(args);
}

void ST7920_PrintfCenteredInRect(char *format, u8 x, u8 y, u8 width, u8 height, bool vertically, bool horizontally, ...)
{
    va_list args;
    va_start(args, format);

    vsprintf(ST7920_PrintfBuf, format, args);
    ST7920_DrawStringCenteredInRect(ST7920_PrintfBuf, x, y, width, height, vertically, horizontally);

    va_end(args);
}

void ST7920_DrawChar(char chr)
{
    ST7920_Glyph *glyph = ST7920_FontGlyphs + chr;

    u8 drawingStartEnd = glyph->drawingStartEnd;

    u8 drawingStart = (drawingStartEnd >> 0) & 0b111;
    u8 drawingEnd   = (drawingStartEnd >> 3) & 0b111;

    int glyphWidth = ST7920_MONOSPACE ? 8 : 1 + drawingEnd - drawingStart;

    if (ST7920_CursorX + glyphWidth > ST7920_WrapX)
    {
        ST7920_CursorX = ST7920_OriginX;
        ST7920_CursorY += ST7920_LINE_HEIGHT;
    }

    for (int localX = drawingStart, i = 0; i < glyphWidth && ST7920_CursorX < ST7920_WrapX; ST7920_CursorX++, localX++, i++)
    {
        u8 column = glyph->cols[localX];

        u8 rightShift = ST7920_CursorX % 8;
        u8 mask       = ~(0x80 >> rightShift);

        for (int y = ST7920_CursorY, j = 7; j >= 0 && y < 64; j--, y++)
        {
            u8  rowIdx = ST7920_CursorX / 8;
            u16 pxIdx  = y * 16 + rowIdx;

            u8 row = ST7920_BackBuf[pxIdx];
            row &= mask;
            u8 bit = column << j & 0x80;
            row |= bit >> rightShift;

            ST7920_BackBuf[pxIdx] = row;
        }
    }
}

void ST7920_DrawStringLen(char *str, u8 length)
{
    for (int i = 0; i < length; ++i)
    {
        char c = *str++;
        if (c == '\n')
        {
            ST7920_CursorY += ST7920_LINE_HEIGHT;
            ST7920_CursorX = ST7920_OriginX;
            continue;
        }

        ST7920_DrawChar(c);
        ST7920_CursorX += ST7920_FONT_SPACING_X;
    }
}

void ST7920_DrawString(char *str)
{
    ST7920_DrawStringLen(str, strlen(str));
}

void ST7920_DrawStringLenCenteredInRect(char *str, u8 length, u8 x, u8 y, u8 width, u8 height, bool vertically, bool horizontally)
{
    // ST7920_DrawRectangle(x, y, width, height, 1);

    if (!vertically && !horizontally)
    {
        ST7920_SetOrigin(x, y);
        ST7920_CursorY = y;
        ST7920_DrawStringLen(str, length);

        return;
    }

    u8 lineLengths[64 / ST7920_FONT_HEIGHT];
    u8 pixelLenCurrentLine = 0;
    u8 pixelHeight         = 0;
    u8 line                = 0;

    for (int i = 0; i < length; ++i)
    {
        char c = str[i];

        if (c != '\n')
        {
            ST7920_Glyph *glyph = ST7920_FontGlyphs + c;

            u8 drawingStartEnd = glyph->drawingStartEnd;

            u8 drawingStart = (drawingStartEnd >> 0) & 0b111;
            u8 drawingEnd   = (drawingStartEnd >> 3) & 0b111;

            int glyphWidth = ST7920_FONT_SPACING_X + 1 + drawingEnd - drawingStart;
            pixelLenCurrentLine += glyphWidth;
        }

        if (c == '\n' || i == length - 1)
        {
            lineLengths[line++] = pixelLenCurrentLine;
            pixelLenCurrentLine = 0;
            pixelHeight += ST7920_LINE_HEIGHT;
        }
    }

    // f32 marginY = vertically ? (height - pixelHeight) / 2.0F : 0;
    // f32 cursorY = marginY >= 0 ? y + marginY : y;

    int marginY = vertically ? ((int) height - pixelHeight) / 2 : 0;
    u8  cursorY = marginY >= 0 ? y + marginY : y;

    ST7920_CursorY = cursorY;

    line        = 0;
    u8 lastLine = 0xFF;

    for (int i = 0; i < length; ++i)
    {
        if (line != lastLine)
        {
            int marginX = horizontally ? ((int) width - lineLengths[line]) / 2 : 0;
            u8 cursorX = marginX >= 0 ? x + marginX : x;

            // ST7920_DrawRectangle(x, ST7920_CursorY, marginX, ST7920_LINE_HEIGHT, 1);

            ST7920_OriginX = cursorX;
            ST7920_CursorX = cursorX;
        }
        lastLine = line;

        // ST7920_DrawRectangle(ST7920_OriginY, ST7920_CursorY, max(lineLengths[line], 1), ST7920_FONT_HEIGHT, 1);

        char c = *str++;
        if (c == '\n')
        {
            line++;
            ST7920_CursorY += ST7920_LINE_HEIGHT;
            continue;
        }

        ST7920_DrawChar(c);
        ST7920_CursorX += ST7920_FONT_SPACING_X;
    }

    ST7920_CursorX = x;
}

void ST7920_DrawStringCenteredInRect(char *str, u8 x, u8 y, u8 width, u8 height, bool vertically, bool horizontally)
{
    ST7920_DrawStringLenCenteredInRect(str, strlen(str), x, y, width, height, vertically, horizontally);
}

void ST7920_DrawLineHorizontal(u8 x, u8 y, u8 length)
{
    // ensure the line doesn't go off-screen
    u8 newLen = length;
    if (x + newLen > 128)
    {
        newLen -= x;
    }

    u8 modX = x & 7;

    u16 yIdx        = y * 16;
    int rowIdxStart = x / 8;
    if (modX)
    {
        u8 leftShift = 8 - modX;
        ST7920_BackBuf[yIdx + rowIdxStart] |= (1 << leftShift) - 1;
        if (leftShift > newLen)
        {
            ST7920_BackBuf[yIdx + rowIdxStart] &= ~((1 << (newLen - modX)) - 1);
            return;
        }

        if (leftShift == newLen)
        {
            return;
        }

        newLen -= leftShift;
        rowIdxStart++;
    }

    int rowIdx, i;
    for (i = 0, rowIdx = rowIdxStart; i < newLen / 8; rowIdx++, i++)
    {
        ST7920_BackBuf[yIdx + rowIdx] = 0xFF;
    }

    u8 modLen = newLen & 7;
    if (modLen)
    {
        ST7920_BackBuf[yIdx + rowIdx] |= ((1 << modLen) - 1) << (8 - modLen);
    }
}

void ST7920_DrawLineVertical(u8 x, u8 y, u8 length)
{
    // ensure the line doesn't go off-screen
    u8 newLen = length;
    if (y + newLen > 64)
    {
        newLen -= y;
    }

    u8 shift = x & 7;
    u8 xIdx  = x / 8;

    for (int i = 0; i < newLen; y++, i++)
    {
        ST7920_BackBuf[(y * 16 + xIdx)] |= 0x80 >> shift;
    }
}

void ST7920_DrawRectangle(u8 x, u8 y, u8 width, u8 height, u8 thickness)
{
    for (int i = 0; i < thickness; ++i)
    {
        // vertical
        ST7920_DrawLineHorizontal(x, y + i, width);
        ST7920_DrawLineHorizontal(x, y + height - i - 1, width);

        // horizontal
        ST7920_DrawLineVertical(x + i, y + thickness, height - 2 * thickness);
        ST7920_DrawLineVertical(x + width - i - 1, y + thickness, height - 2 * thickness);
    }
}

const u8 ST7920_Font[2304] = {
    0x31, 0x00, 0x66, 0x66, 0x18, 0x18, 0x66, 0x66, 0x00, 0x31, 0x00, 0x66, 0x66, 0x18, 0x18, 0x66,
    0x66, 0x00, 0x31, 0x00, 0x66, 0x66, 0x18, 0x18, 0x66, 0x66, 0x00, 0x31, 0x00, 0x66, 0x66, 0x18,
    0x18, 0x66, 0x66, 0x00, 0x31, 0x00, 0x66, 0x66, 0x18, 0x18, 0x66, 0x66, 0x00, 0x31, 0x00, 0x66,
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    0x66, 0x66, 0x18, 0x18, 0x66, 0x66, 0x00, 0x31, 0x00, 0x66, 0x66, 0x18, 0x18, 0x66, 0x66, 0x00,
};
